#define __SFR_OFFSET 0x00
#include "avr/io.h"
.global main
LCD_buffer:
LDS R27, UCSR0A
SBRS R27, UDRE0
RJMP LCD_buffer
RET
ASCII_MSD:
MOV R23, R16
ANDI R16, 0xF0
SWAP R16
SUBI R16, -48
MOV R28, R16
SUBI R28, 58
BRPL A_F_D1
l1:
RET
A_F_D1:
SUBI R16, -7
RJMP l1
ASCII_LSD:
MOV R16, R23
ANDI R16, 0x0F
SUBI R16, -48
MOV R28, R16
SUBI R28, 58
BRPL A_F_D0
l2:
RET
A_F_D0:
SUBI R16, -7
RJMP l2
main:
serial_init:
CLR R24
STS UCSR0A, R24
STS UBRR0H, R24
LDI R24, 103
STS UBRR0L, R24
LDI R24, 1<<RXEN0 | 1<<TXEN0
STS UCSR0B, R24
LDI R24, 1<<UCSZ00 | 1<<UCSZ01
STS UCSR0C, R24

myDelay:
LDI R20, 255
lay1:
LDI R21, 255
lay2:
LDI R22, 20
lay3:
DEC R22
BRNE lay3
DEC R21
BRNE lay2
DEC R20
BRNE lay1
JMP button